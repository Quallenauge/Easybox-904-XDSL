## package/infineon-utilities/feeds/ifx_feeds_uboot/open_uboot/config/Kconfig
```kconfig
config LANTIQ_UBOOT_danube
	bool
	default y
	depends on ( TARGET_ltqcpe_platform_danube || TARGET_ifxcpe_platform_danube )

config LANTIQ_UBOOT_amazon_se
    bool
	default y
	depends on ( TARGET_ltqcpe_platform_amazon_se || TARGET_ifxcpe_platform_amazon_se )
			
config LANTIQ_UBOOT_ar9
    bool
    default y
    depends on ( TARGET_ltqcpe_platform_ar9 || TARGET_ifxcpe_platform_ar9 )

config LANTIQ_UBOOT_vr9
    bool
	default y
	depends on ( TARGET_ltqcpe_platform_vr9 || TARGET_ifxcpe_platform_vr9 )
			
config LANTIQ_UBOOT_ar10
    bool
	default y
	depends on ( TARGET_ltqcpe_platform_ar10 || TARGET_ifxcpe_platform_ar10 )


source package/infineon-utilities/feeds/ifx_feeds_uboot/open_uboot/config/scripts_platform/Kconfig
```

## target/linux/ltqcpe/image/Config.in
```kconfig
config TARGET_ROOTFS_JFFS2_BLOCK_SIZE
	string
	prompt "jffs2 block size"
	depends on TARGET_ROOTFS_JFFS2
	help
	  jffs2 block size for target images
```
