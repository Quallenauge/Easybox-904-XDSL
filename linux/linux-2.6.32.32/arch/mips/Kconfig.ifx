## package/boot/uboot-lantiq-easybox904xdsl/src.ifx/scripts_platform/Kconfig
```kconfig
#
# For a description of the syntax of this configuration file,
# see Linux Documentation
#
#

config IFX_UBOOT_OPTIMIZED
      bool
      default y

config CONFIG_REMOVE_GZIP
      bool
    default y

config CONFIG_IFX_MIPS
      bool
      default y

config CROSS_COMPILE_UCLIBC
      bool
      default y

config LANTIQ_UART
	  bool
	  default y

menu "Build Options"

choice
    prompt 'Boot From'

config BOOT_FROM_NOR
    bool "NOR Flash"
    select ENV_IS_IN_FLASH
	depends on !LANTIQ_UBOOT_ar10

config BOOT_FROM_SPI
    bool "SPI Flash"
    select ENV_IS_IN_SPI_FLASH
    select SPI_FLASH
    help
    Boots from SPI flash.

config BOOT_FROM_NAND
    bool "NAND Flash"
    select NAND_FLASH
    select NAND_U_BOOT
	help
    Boots from NAND flash.

config BOOT_FROM_ETHERNET
    bool "ETHERNET"
	select ENV_IS_NOWHERE
    help
    Boots from ethernet port.

config BOOT_FROM_UART
    bool "UART"
    select ENV_IS_IN_FLASH
    help
    Boots from asc port.

config BOOT_WITH_NO_FLASH
    bool "NO FLASH"
    select ENV_IS_NOWHERE

endchoice

config ENV_IS_NOWHERE
    bool "ENV_IS_NOWHERE"
	default n

config JFFS2_PART
    bool "writable JFFS2 partition support"
	depends on NAND_FLASH && FIRMWARE_IN_ROOTFS
    default n

config IN_SUPERTASK
	bool "Boot from supertask"
	default n
	depends on NOR_FLASH && (NOR_FLASH_16M || NOR_FLASH_32M) && FIRMWARE_IN_ROOTFS
	help
	Boots from supertask

config DUAL_IMAGE
	bool "dual image"
	default n
	depends on ( NAND_FLASH || NOR_FLASH && NOR_FLASH_32M ) && FIRMWARE_IN_ROOTFS
	help
	dual image support

config ENV_IS_IN_FLASH
    bool

config ENV_IS_IN_SPI_FLASH
    bool

config ENV_IS_IN_NAND
    bool
	default y
	depends on BOOT_FROM_NAND && !ENV_IS_NOWHERE

config ENV_IS_NOWHERE
    bool

config NAND_U_BOOT
    bool

config RAM_TEXT_BASE
    hex "RAM TEXTBASE" 
	default "0xA0400000"

config BOOTSTRAP_TEXT_BASE
    hex "BOOTSTRAP TEXTBASE"
	default "0xB0000000" if ( BOOT_FROM_NOR )
	default "0xA0100000" if ( !BOOT_FROM_NOR )

config NAND_PRELOAD_TEXT_BASE
	hex
	default "0xbe1a0000" if LANTIQ_UBOOT_ar9
	default "0xbe220000" if LANTIQ_UBOOT_vr9
	default "0xbe1a0000" if LANTIQ_UBOOT_ar10

config NAND_SPL_TEXT_BASE
    hex 
	default "0xBE1a0400"  if LANTIQ_UBOOT_ar9
    default "0xBE220400"  if LANTIQ_UBOOT_vr9
	default "0xBE1A0000"  if LANTIQ_UBOOT_ar10
	depends on BOOT_FROM_NAND

config SFDDR_TEXT_BASE
	hex 
	default "0xbe1a0000" if LANTIQ_UBOOT_ar9
	default "0xbe220500" if LANTIQ_UBOOT_vr9
	depends on BOOT_FROM_SPI

choice
     prompt "OS COMPRESSION TYPE"
     default OS_LZMA

config OS_GZIP
     bool "GZIP"

config OS_LZMA
     bool "LZMA"

config OS_LZO
     bool "LZO"

config OS_BZIP2
     bool "BZIP2"

endchoice
						   


config IFX_IMAGE_EXTRA_CHECKS
    bool "IFX IMAGE EXTRA CHECK"
	default n
		
config VENDOR_NAME
    string 
	default "LANTIQ"
	depends on IFX_IMAGE_EXTRA_CHECKS

config SW_VERSION
    string 
	default "4.2.0"
	depends on IFX_IMAGE_EXTRA_CHECKS

config DEBUG
    bool "VERBOSE"
	default n

endmenu

menu "Board Settings"

config IFX_MEMORY_SIZE
        int "RAM Size(M)"
        default 64

config ASC_BAUDRATE
  string "ASC BAUDRATE"
  default "115200"


config NOR_FLASH
        bool "NOR FLASH SUPPORT"
        default y
        select CMD_FLASH
		depends on !LANTIQ_UBOOT_ar10

config SYS_NO_FLASH
       bool
	   default y
	   depends on !NOR_FLASH

config FLASH_CFI_DRIVER
       bool
	   default y
	   depends on NOR_FLASH

config SYS_FLASH_CFI
       bool
	   default y
	   depends on NOR_FLASH

config FLASH_CFI_MTD
	   bool "MTD SUPPORT"
	   default n
	   depends on NOR_FLASH

choice
     prompt "NOR Flash Size(M)"
     depends on BOOT_FROM_NOR
     default NOR_FLASH_8M

config NOR_FLASH_32M
     bool "32M"

config NOR_FLASH_16M
     bool "16M"

config NOR_FLASH_8M
     bool "8M"

config NOR_FLASH_4M
     bool "4M"

config NOR_FLASH_2M
     bool "2M"

config NOR_FLASH_AUTO
     bool "auto detect"

endchoice


config SPI_FLASH
      bool "SPI FLASH SUPPORT"
        select LANTIQ_SPI
      select CMD_SF

choice
     prompt "SPI Flash Size(M)"
	 depends on BOOT_FROM_SPI
	 default SPI_FLASH_4M

config SPI_FLASH_8M
     bool "8M"

config SPI_FLASH_4M
     bool "4M"

config SPI_FLASH_2M
     bool "2M"

config SPI_FLASH_1M
     bool "1M"

config SPI_FLASH_512K
     bool "512K"

config SPI_FLASH_256K
     bool "256K"

endchoice
							  

config SPI_FLASH_ATMEL
        bool "ATMEL SFLASH SUPPORT"
    depends on SPI_FLASH

config SPI_FLASH_STMICRO
        bool  "STMICRO SFLASH SUPPORT"
    depends on SPI_FLASH

config SPI_FLASH_SST
        bool "SST SFLASH SUPPORT"
        depends on SPI_FLASH

config SPI_FLASH_SPANSION
        bool "SPANSION SFLASH SUPPORT"
    depends on SPI_FLASH

config SPI_FLASH_MXIC
        bool "MXIC SFLASH SUPPORT"
    depends on SPI_FLASH

config SPI_FLASH_WINBOND
        bool "WINBOND SFLASH SUPPORT"
    depends on SPI_FLASH

config LANTIQ_SPI
        bool

config  SF_DEFAULT_SPEED
        int "SPI FLASH BAUDRATE(Hz)"
    default "1000000"
        depends on SPI_FLASH

config SF_DEFAULT_MODE
        int "SFLASH SPI MODE"
    default "0"
    depends on LANTIQ_SPI

config SPI_EEPROM
        bool "SPI EEPROM SUPPORT"
    select CMD_EEPROM
    select LANTIQ_SPI
    select SPI_EEPROM_ATMEL


config SPI_EEPROM_ATMEL
        bool "ATMEL 250X0 SUPPORT"
        depends on SPI_EEPROM


config  EEPROM_DEFAULT_SPEED
        int "EEPROM BAUDRATE(Hz)"
    default "1000000"
    depends on SPI_EEPROM

config  EEPROM_DEFAULT_MODE
        int "EEPROM SPI MODE"
        default "0"
        depends on SPI_EEPROM


config NAND_FLASH
      bool "NAND FLASH_SUPPORT"
      select CMD_NAND
      select NAND_LANTIQ

choice 
      prompt "ECC MODE"
	  depends on NAND_FLASH
	  default NAND_ECC_SOFT

config NAND_ECC_SOFT
       bool "SOFTWARE"
	  
config NAND_ECC_HW_HAMMING
       bool "HARDWARE HAMMING"

config NAND_ECC_HW_REED_SOLOMON
       bool "HARDWARE REED SOLOMON"

endchoice

choice 
     prompt "ECC LOCATION"
     depends on NAND_ECC_HW_REED_SOLOMON
     default NAND_HW_ECC_SPARE_AREA

config NAND_HW_ECC_SPARE_AREA
      bool "ECC IN OOB AREA"

config NAND_HW_ECC_EMBEDDED
      bool "ECC EMBEDDED IN DATA AREA"
	  
endchoice


config NAND_ECC_HW
	  bool
	  depends on NAND_ECC_HW_HAMMING || NAND_ECC_HW_REED_SOLOMON
	  default y

config NAND_BBT_SCAN
        bool "BAD NAND BLOCK SCAN"
        depends on NAND_FLASH

config NAND_LANTIQ
       bool
       depends on NAND_FLASH

config NAND_CS0
       bool "NAND FLASH ON CS0"
	   default y
	   depends on NAND_FLASH 
	   depends on LANTIQ_UBOOT_ar10

choice
     prompt "NAND Flash Size(M)"
	 depends on BOOT_FROM_NAND
	 default NAND_FLASH_4M

config NAND_FLASH_4096M
	 bool "4096M" 

config NAND_FLASH_128M
     bool "128M"

config NAND_FLASH_512M
     bool "512M"

config NAND_FLASH_64M
     bool "64M"

config NAND_FLASH_32M
     bool "32M"

config NAND_FLASH_16M
     bool "16M"

config NAND_FLASH_8M
     bool "8M"

config NAND_FLASH_4M
     bool "4M"

config NAND_FLASH_2M
     bool "2M"

endchoice


config NAND_FLASH_SIZE
	### ctc ###
#    hex
	int 
	###########
	default "2" if ( NAND_FLASH_2M )
	default "4" if ( NAND_FLASH_4M )
	default "8" if ( NAND_FLASH_8M )
	### ctc ###
	default "16" if ( NAND_FLASH_16M )
	###########
	default "32" if ( NAND_FLASH_32M )
	default "64" if ( NAND_FLASH_64M )
	default "128" if ( NAND_FLASH_128M )
	default "512" if ( NAND_FLASH_512M )
	default "4096" if ( NAND_FLASH_4096M )
	
config NAND_PAGE_SIZE
     hex "NAND flash page size(bytes)"
     default "0x200"
	### ctc ###
#     depends on ( TUNE_DDR && BOOT_FROM_NAND)
     depends on ( BOOT_FROM_NAND)
	###########


config FIRMWARE_IN_ROOTFS
     bool "firmware in rootfs"
     default y

config OVERLAY
	 bool "overlay fs support"
	 default n
	 depends on DRIVER_VR9 || DRIVER_AR9 || DRIVER_DANUBE

if LANTIQ_UBOOT_ar9
   source board/ar9/Kconfig
endif

if LANTIQ_UBOOT_danube
   source board/danube/Kconfig
endif

if LANTIQ_UBOOT_amazon_se
   source board/amazon_se/Kconfig
endif

if LANTIQ_UBOOT_vr9
   source board/vr9/Kconfig
endif

if LANTIQ_UBOOT_ar10
   source board/ar10/Kconfig
endif
   

endmenu


menu "Network Settings"
config IP_ADDRESS
    string "IP address"
    default "192.168.2.1"

config SERVER_IP_ADDRESS
    string "Server IP address"
    default "192.168.2.100"

config ETHERNET_ADDRESS
    string "Ethernet Address"
    default "00:E0:92:00:01:40"

config ETHERNET_DEVICE
    string "Ethernet Interface"
    default "eth0"
endmenu

menu "Environment Settings"

config ENV_REDUND
    bool "redundant env"
	default no
	depends on ENV_IS_IN_FLASH

config ENV_OVERWRITE
	bool "enable env overwrite"
	default y

config TFTP_LOAD_ADDRESS
    string "tftp load address"
    default "0x80800000"
    
config MEM
    string "mem"
    default "62M"

config PHYM
    string "phym"
    default "64M"

config ROOT_PATH
    string "rootpath"
    default "/mnt/full_fs"


config CONSOLE
    string "console"
	default "ttyS1"   

config TFTPPATH
    string "tftppath"
	default ""

config NFSARGS
    string "nfsargs"
    default "setenv bootargs root=/dev/nfs rw nfsroot=$(serverip):$(rootpath)"

config RAMARGS
    string "ramargs"
    default "setenv bootargs root=/dev/ram rw"

config FLASHARGS
    string "flashargs"
    default "setenv bootargs root=$(rootfsmtd) rw rootfstype=squashfs,jffs2 init=/etc/preinit"

config ADDIP
    string "addip"
    default "setenv bootargs $(bootargs) ip=$(ipaddr):$(serverip):$(gatewayip):$(netmask):$(hostname):$(netdev):on"

config ADDMISC
    string "addmisc"
	default "setenv bootargs $(bootargs) console=$(console),$(baudrate) ethaddr=$(ethaddr) phym=$(phym) mem=$(mem) panic=1 mtdparts=$(mtdparts)" 

config BOOTFILE
    string "bootfile"
    default "uImage"

config USE_DEFAULT_MTDPARTS
    bool "use default MTDPARTS"
	default y


if LANTIQ_UBOOT_danube
config MTDPARTS
    string
	default "ifx_nor0:64k(uboot),256k(firmware),7744k(rootfs),64k(sysconfig),4k(ubootconfig),4k(fwdiag),4k(caliberation),-(res)" if ( BOOT_FROM_NOR && NOR_FLASH_8M  && !FIRMWARE_IN_ROOTFS && !OVERLAY )
	default "ifx_nor0:64k(uboot),256k(firmware),7424k(rootfs),320k(overlay),64k(sysconfig),4k(ubootconfig),4k(fwdiag),4k(caliberation),-(res)" if ( BOOT_FROM_NOR && NOR_FLASH_8M  && !FIRMWARE_IN_ROOTFS && OVERLAY )
	default "ifx_nor0:64k(uboot),8000k(rootfs),64k(sysconfig),4k(ubootconfig),4k(fwdiag),4k(caliberation),-(res)" if ( BOOT_FROM_NOR && NOR_FLASH_8M && FIRMWARE_IN_ROOTFS && !OVERLAY)
	default "ifx_nor0:64k(uboot),7680k(rootfs),320k(overlay),64k(sysconfig),4k(ubootconfig),4k(fwdiag),4k(caliberation),-(res)" if ( BOOT_FROM_NOR && NOR_FLASH_8M && FIRMWARE_IN_ROOTFS && OVERLAY )
	default "ifx_nor0:64k(uboot),-(rootfs)" if ( BOOT_FROM_UART )
	default "" if ( NOR_FLASH_AUTO )
	depends on USE_DEFAULT_MTDPARTS
endif

if LANTIQ_UBOOT_amazon_se
config MTDPARTS
    string
    default "ifx_nor0:64k(uboot),3904k(rootfs),32k(sysconfig),4k(ubootconfig),4k(fwdiag),-(res)" if ( BOOT_FROM_NOR && NOR_FLASH_4M && FIRMWARE_IN_ROOTFS )  
    default "ifx_nor0:64k(uboot),192k(firmware),3796k(rootfs),32k(sysconfig),4k(ubootconfig),4k(fwdiag),-(res)" if ( BOOT_FROM_NOR && NOR_FLASH_4M && !FIRMWARE_IN_ROOTFS )
	default "ifx_nor0:64k(uboot),256k(firmware),7744k(rootfs),64k(sysconfig),4k(ubootconfig),4k(fwdiag),4k(caliberation),-(res)" if ( BOOT_FROM_NOR && NOR_FLASH_8M  && !FIRMWARE_IN_ROOTFS )
	default "ifx_nor0:64k(uboot),8000k(rootfs),64k(sysconfig),4k(ubootconfig),4k(fwdiag),4k(caliberation),-(res)" if ( BOOT_FROM_NOR && NOR_FLASH_8M && FIRMWARE_IN_ROOTFS )
	default "ifx_sflash:64k(uboot),3904k(rootfs),32k(sysconfig),4k(ubootconfig),4k(fwdiag),-(res)" if ( BOOT_FROM_SPI && SPI_FLASH_4M && FIRMWARE_IN_ROOTFS )
	default "ifx_sflash:64k(uboot),192k(firmware),3796k(rootfs),32k(sysconfig),4k(ubootconfig),4k(fwdiag),-(res)" if ( BOOT_FROM_SPI && SPI_FLASH_4M && !FIRMWARE_IN_ROOTFS )
	default "ifx_sflash:64kk(uboot),192k(firmware),7744k(rootfs),64k(sysconfig),4k(ubootconfig),4k(fwdiag),4k(caliberation),-(res)" if ( BOOT_FROM_SPI && SPI_FLASH_8M && !FIRMWARE_IN_ROOTFS )
	default "ifx_sflash:64k(uboot),-(rootfs)" if ( BOOT_FROM_SPI && FIRMWARE_IN_ROOTFS )
	default "ifx_nand:64k(uboot),-(rootfs)" if ( BOOT_FROM_NAND && FIRMWARE_IN_ROOTFS )
	default "ifx_nand:64k(uboot),192k(firmware),-(rootfs)" if ( BOOT_FROM_NAND && !FIRMWARE_IN_ROOTFS )
	default "ifx_nor0:64k(uboot),-(rootfs)" if ( BOOT_FROM_UART )
	default "" if ( NOR_FLASH_AUTO )
	depends on USE_DEFAULT_MTDPARTS
endif


if LANTIQ_UBOOT_ar9
config MTDPARTS
    string
	default "ifx_nor0:64k(uboot),192k(firmware),-(rootfs)" if ( BOOT_FROM_NOR && NOR_FLASH_4M && !FIRMWARE_IN_ROOTFS )
	default "ifx_sflash:64k(uboot),3904k(rootfs),32k(sysconfig),4k(ubootconfig),-(res)" if ( BOOT_FROM_SPI && SPI_FLASH_4M && !FIRMWARE_IN_ROOTFS )
	default "ifx_nor0:64k(uboot),256k(firmware),7744k(rootfs),64k(sysconfig),4k(ubootconfig),4k(fwdiag),4k(caliberation),-(res)" if ( BOOT_FROM_NOR && NOR_FLASH_8M  && !FIRMWARE_IN_ROOTFS && !OVERLAY )
	default "ifx_nor0:64k(uboot),256k(firmware),7424k(rootfs),320k(overlay),64k(sysconfig),4k(ubootconfig),4k(fwdiag),4k(caliberation),-(res)" if ( BOOT_FROM_NOR && NOR_FLASH_8M  && !FIRMWARE_IN_ROOTFS && OVERLAY )
	default "ifx_nor0:64k(uboot),8000k(rootfs),64k(sysconfig),4k(ubootconfig),4k(fwdiag),4k(caliberation),-(res)" if ( BOOT_FROM_NOR && NOR_FLASH_8M && FIRMWARE_IN_ROOTFS && !OVERLAY )
	default "ifx_nor0:64k(uboot),7680k(rootfs),320k(overlay),64k(sysconfig),4k(ubootconfig),4k(fwdiag),4k(caliberation),-(res)" if ( BOOT_FROM_NOR && NOR_FLASH_8M && FIRMWARE_IN_ROOTFS && OVERLAY )
	default "ifx_sflash:128k(uboot),192k(firmware),-(rootfs)" if ( BOOT_FROM_SPI && SPI_FLASH_1M && !FIRMWARE_IN_ROOTFS )
	default "ifx_sflash:128k(uboot),192k(firmware),7744k(rootfs),64k(sysconfig),4k(ubootconfig),4k(fwdiag),4k(caliberation),-(res)" if ( BOOT_FROM_SPI && SPI_FLASH_8M && !FIRMWARE_IN_ROOTFS )
	default "ifx_sflash:128k(uboot),-(rootfs)" if ( BOOT_FROM_SPI && FIRMWARE_IN_ROOTFS )
	default "ifx_nand:128k(uboot),2688k(kernel),28800k(rootfs),64k(sysconfig),16k(ubootconfig),16k(fwdiag),-(res)" if ( BOOT_FROM_NAND && FIRMWARE_IN_ROOTFS )
	default "ifx_nand:128k(uboot),192k(firmware),-(rootfs)" if ( BOOT_FROM_NAND && !FIRMWARE_IN_ROOTFS )
	default "ifx_nor0:64k(uboot),-(rootfs)" if ( BOOT_FROM_UART )
	default "" if ( NOR_FLASH_AUTO )
	depends on USE_DEFAULT_MTDPARTS
endif



if LANTIQ_UBOOT_vr9
config MTDPARTS
    string "MTDPARTS"
	default "ifx_nor0:128k(uboot),-(rootfs)" if ( BOOT_FROM_NOR && FIRMWARE_IN_ROOTFS && !NOR_FLASH_16M && !NOR_FLASH_32M)
	default "ifx_nor0:128k(uboot),512k(firmware),-(rootfs)" if ( BOOT_FROM_NOR && !FIRMWARE_IN_ROOTFS )
	default "ifx_nor0:128k(uboot),13184k(rootfs),2m(kernel),768k(sysconfig),128k(ubootconfig),128k(fwdiag)" if ( BOOT_FROM_NOR && !NAND_FLASH && FIRMWARE_IN_ROOTFS && NOR_FLASH_16M && !IN_SUPERTASK )
	default "ifx_nor0:256k(uboot),13056k(rootfs),2m(kernel),768k(sysconfig),128k(ubootconfig),128k(fwdiag)" if ( BOOT_FROM_NOR && NAND_FLASH && FIRMWARE_IN_ROOTFS && NOR_FLASH_16M && !IN_SUPERTASK )
	default "ifx_nor0:128k(uboot),8448k(supertask1),128k(uboot-bin),7296k(rootfs),128k(linux-cfg),256k(supertask2)" if ( BOOT_FROM_NOR && FIRMWARE_IN_ROOTFS && NOR_FLASH_16M && IN_SUPERTASK )
	default "ifx_nor0:128k(uboot),29568k(rootfs),2m(kernel),768k(sysconfig),128k(ubootconfig),128k(fwdiag)" if ( BOOT_FROM_NOR && !NAND_FLASH && FIRMWARE_IN_ROOTFS && NOR_FLASH_32M && !IN_SUPERTASK )
	default "ifx_nor0:256k(uboot),29440k(rootfs),2m(kernel),768k(sysconfig),128k(ubootconfig),128k(fwdiag)" if ( BOOT_FROM_NOR && NAND_FLASH && FIRMWARE_IN_ROOTFS && NOR_FLASH_32M && !IN_SUPERTASK )
	default "ifx_nor0:128k(uboot),8448k(supertask1),128k(uboot-bin),7296k(rootfs),128k(linux-cfg),16640k(supertask2)" if ( BOOT_FROM_NOR && FIRMWARE_IN_ROOTFS && NOR_FLASH_32M && IN_SUPERTASK )
	default "ifx_sflash:192k(uboot),512k(firmware),-(rootfs)" if ( BOOT_FROM_SPI && !FIRMWARE_IN_ROOTFS )
	default "ifx_sflash:192k(uboot),-(rootfs)" if ( BOOT_FROM_SPI && FIRMWARE_IN_ROOTFS )
    default "ifx_nand:256k(uboot),-(rootfs)" if ( BOOT_FROM_NAND && FIRMWARE_IN_ROOTFS )
	default "ifx_nand:256k(uboot),512k(firmware),-(rootfs)" if ( BOOT_FROM_NAND && !FIRMWARE_IN_ROOTFS )
	default "ifx_nor0:128k(uboot),-(rootfs)" if ( BOOT_FROM_UART )
	depends on USE_DEFAULT_MTDPARTS
endif


if LANTIQ_UBOOT_ar10
config MTDPARTS
    string 
    default "ifx_nand:64k(uboot),-(rootfs)"
	depends on USE_DEFAULT_MTDPARTS
endif

config MTDPARTS
    string "MTDPARTS"
	default "ifx_nor0:128k(uboot),13184k(rootfs),2m(kernel),768k(sysconfig),128k(ubootconfig),128k(fwdiag)" if ( ( NOR_FLASH_16M || NOR_FLASH_32M ) && FIRMWARE_IN_ROOTFS )
	default "ifx_nor0:64k(uboot),-(rootfs)"  if ( !NOR_FLASH_16M && !NOR_FLASH_32M || !FIRMWARE_IN_ROOTFS )
	depends on !USE_DEFAULT_MTDPARTS


config NET_RAM
    string "net_ram"
    default "tftp $(loadaddr) $(tftppath)$(bootfile); run ramargs addip addmisc; bootm"

config NET_FLASH
    string "net_flash"
    default "tftp $(loadaddr) $(tftppath)$(bootfile); run flashargs addip addmisc; bootm"

config FLASH_NFS
    string "flash_nfs"
    default "run nfsargs addip addmisc;bootm $(kernel_addr)"

config NET_NFS
    string "net_nfs"
    default "tftp $(loadaddr) $(tftppath)$(bootfile);run nfsargs addip addmisc;bootm"

config FLASH_FLASH
    string "flash_flash"
    default "run flashargs addip addmisc; bootm $(kernel_addr)" if ( !UBOOT_CONFIG_BOOT_FROM_NAND )
    default "nand read.e $(loadaddr) $(f_kernel_addr) $(f_kernel_size); run flashargs addip addmisc; bootm $(loadaddr)" if ( UBOOT_CONFIG_BOOT_FROM_NAND )

config BOOTCOMMAND
    string "bootcmd"
	default "run flash_flash"


if !BOOT_FROM_SPI || !SPI_FLASH_256K && !SPI_FLASH_512K

config ROOTFSMTD
    string "rootfsmtd"
	default "/dev/mtdblock2" if ( BOOT_FROM_NAND && FIRMWARE_IN_ROOTFS )
	default "/dev/mtdblock3" if ( BOOT_FROM_NAND && !FIRMWARE_IN_ROOTFS )
	default "/dev/mtdblock1" if ( BOOT_FROM_NOR && FIRMWARE_IN_ROOTFS && !IN_SUPERTASK )
	default "/dev/mtdblock3" if ( BOOT_FROM_NOR && FIRMWARE_IN_ROOTFS && IN_SUPERTASK )
	default "/dev/mtdblock2" if ( BOOT_FROM_NOR && !FIRMWARE_IN_ROOTFS )
	default "/dev/mtdblock2" if ( BOOT_FROM_SPI && !FIRMWARE_IN_ROOTFS )

config FIRMWARE
    string "firmware"
    default "firmware.img"

config FULLIMAGE
    string "fullimage"
	default "fullimage.img"

config TOTALIMAGE
    string "totalimage"
	default "totalimage.img"

config U_BOOT
    string "u-boot"
    default "u-boot.lq"

config SYSCONFIG
	string "sysconfig"
	default "sysconfig.jffs2-128k.nand"

config ROOTFS
    string "rootfs"
    default "rootfs.img"

config JFFS2IMAGE
    string "jffs2image"
	default "root.jffs2-128k.nor" if ( BOOT_FROM_NOR &&  ( NOR_FLASH_16M || NOR_FLASH_32M ) )
	default "root.jffs2-64k.nor"  if ( BOOT_FROM_NOR && !( NOR_FLASH_16M || NOR_FLASH_32M ) )
	default "root.jffs2-16k.nand" if ( BOOT_FROM_NAND )

config UPDATE_NANDBOOT
    string "update_nandboot"
	default "tftp $(loadaddr) $(tftppath)u-boot-nand.bin; nand erase clean 0 0x08000000; nand write $(loadaddr) 0 $(filesize)"
	depends on BOOT_FROM_NAND

config UPDATE_UBOOT
    string "update_uboot"
    default "tftpboot $(loadaddr) $(tftppath)$(u-boot); erase b0000000 +20000;cp.b $(loadaddr) b0000000 $(filesize); reset" if ( !NAND_FLASH )
    default "tftpboot $(loadaddr) $(tftppath)$(u-boot); erase b0000000 +30000;cp.b $(loadaddr) b0000000 $(filesize); reset" if ( BOOT_FROM_NOR && NAND_FLASH )
    default "tftpboot $(loadaddr) $(tftppath)$(u-boot); nand erase $(f_uboot_addr) $(f_uboot_size); nand write.partial $(loadaddr) $(f_uboot_addr) $(filesize); reset" if ( BOOT_FROM_NAND )

config UPDATE_KERNEL
    string "update_kernel"
    default "tftpboot $(loadaddr) $(tftppath)$(bootfile);upgrade $(loadaddr) $(filesize)"

config UPDATE_ROOTFS
    string "update_rootfs"
    default "tftpboot $(loadaddr) $(tftppath)$(rootfs); upgrade $(loadaddr) $(filesize)"

config UPDATE_ALL
	string "update_all"
	default "run update_kernel; run update_rootfs"

config UPDATE_FIRMWARE
    string "update_firmware"
    default "tftpboot $(loadaddr) $(tftppath)$(firmware);upgrade $(loadaddr) $(filesize)"

config UPDATE_FULLIMAGE
    string "update_fullimage"
	default "tftpboot $(loadaddr) $(tftppath)$(fullimage);upgrade $(loadaddr) $(filesize)"

config UPDATE_TOTALIMAGE
    string "update_totalimage"
	default "tftpboot $(loadaddr) $(tftppath)$(totalimage);upgrade $(loadaddr) $(filesize)"

config UPDATE_JFFS2IMAGE
    string "update_jffs2image"
	default "tftpboot $(loadaddr) $(tftppath)$(jffs2image); erase $(f_rootfs_addr) 0xb07fffff; upgrade $(loadaddr) $(filesize)"  if ( BOOT_FROM_NOR && NOR_FLASH_8M )
	default "tftpboot $(loadaddr) $(tftppath)$(jffs2image); erase $(f_rootfs_addr) +0x0ce0000; upgrade $(loadaddr) $(filesize)"  if ( BOOT_FROM_NOR && NOR_FLASH_16M )
	default "tftpboot $(loadaddr) $(tftppath)$(jffs2image); erase $(f_rootfs_addr) +0x1ce0000; upgrade $(loadaddr) $(filesize)"  if ( BOOT_FROM_NOR && NOR_FLASH_32M )
	default "mw.l 80800000 0xffffffff 800000; tftpboot 80800000 $(tftppath)$(jffs2image); nand erase $(f_rootfs_addr) $(f_rootfs_size); nand write.e 80800040 $(f_rootfs_addr) $(filesize)"  if ( BOOT_FROM_NAND )

config UPDATE_FLASH
    string "update_flash"
	default "tftp $(loadaddr) flash3.img; protect off b1000000 +800000; erase b1000000 +800000; cp.b $(loadaddr) b1000000 800000;  tftp $(loadaddr) flash2.img; protect off b0800000 +800000; erase b0800000 +800000; cp.b $(loadaddr) b0800000 800000; tftp $(loadaddr) flash4.img; protect off b1800000 +800000; erase b1800000 +800000; cp.b $(loadaddr) b1800000 800000;  tftp $(loadaddr) flash1.img; protect off b0000000 +800000; erase b0000000 +800000; cp.b $(loadaddr) b0000000 800000" if ( BOOT_FROM_NOR && NOR_FLASH_32M )
	default "tftp $(loadaddr) flash2.img; protect off b0800000 +800000; erase b0800000 +800000; cp.b $(loadaddr) b0800000 800000;  tftp $(loadaddr) flash1.img; protect off b0000000 +800000; erase b0000000 +800000; cp.b $(loadaddr) b0000000 800000" if ( BOOT_FROM_NOR && NOR_FLASH_16M )
	default "tftp $(loadaddr) flash1.img; protect off b0000000 +$(filesize); erase b0000000 +$(filesize); cp.b $(loadaddr) b0000000 $(filesize)"  if ( BOOT_FROM_NOR && !NOR_FLASH_16M && !NOR_FLASH_8M )

config UPDATE_SYSCONFIG
    string "update_sysconfig"
	depends on NAND_FLASH_32M || NAND_FLASH_512M
    default "tftpboot $(loadaddr) $(tftppath)$(sysconfig); nand erase $(f_sysconfig_addr) $(f_sysconfig_size); nand write.partial $(loadaddr) $(f_sysconfig_addr) $(filesize)"

config UPDATE_KERNEL2
	string "update_kernel2"
	depends on DUAL_IMAGE

config UPDATE_ROOTFS2
	string "update_rootfs2"
	depends on DUAL_IMAGE

config UPDATE_JFFS2IMAGE2
	string "update_jffs2image2"
	depends on DUAL_IMAGE

config UPDATE_ALL2
	string "upadte_all2"
	depends on DUAL_IMAGE
	default "run update_kernel2; run update_rootfs2"

config UPDATE_DUAL
	string "upadte_dual"
	depends on DUAL_IMAGE
	default "run update_kernel ; run update_rootfs ; run update_kernel2 ; run update_rootfs2"
endif


if BOOT_FROM_SPI && ( SPI_FLASH_256K || SPI_FLASH_512K )

config ROOTFSMTD
    string "rootfsmtd"
	default "/dev/mtdblock1"
    select ENV_IS_IN_NAND

config U_BOOT
    string "u-boot"
    default "u-boot.sflash"

config ROOTFS
    string "rootfs"
    default "rootfs.img"

config JFFS2IMAGE
    string "jffs2image"
	default "root.jffs2.nand"

config UPDATE_UBOOT
    string "update_uboot"
	default "tftpboot $(loadaddr) $(tftppath)$(u-boot); sf erase 0 40000; sf write $(loadaddr) 0 $(filesize); reset" if ( SPI_FLASH_256K )
	default "tftpboot $(loadaddr) $(tftppath)$(u-boot); sf erase 0 80000; sf write $(loadaddr) 0 $(filesize); reset" if ( SPI_FLASH_512K )

config UPDATE_KERNEL
    string "update_kernel"
    default "tftpboot $(loadaddr) $(tftppath)$(bootfile); nand erase $(f_kernel_addr) $(f_kernel_size); nand write $(loadaddr) $(f_kernel_addr) $(f_kernel_size)"

config UPDATE_ROOTFS
    string "update_rootfs"
    default "tftpboot $(loadaddr) $(tftppath)$(jffs2image); nand erase $(f_rootfs_addr) $(f_rootfs_size); nand write.jffs2 $(loadaddr) $(f_rootfs_addr) $(filesize)"

config UPDATE_FLASH
    string "update_flash"
	default "nand erase; tftp $(loadaddr) part0.img; nand write $(loadaddr) f_$(data_block0)_addr $(filesize); tftp $(loadaddr) part1.img; nand write $(loadaddr) f_$(data_block1)_addr $(filesize); tftp $(loadaddr) part2.img; nand write $(loadaddr) f_$(data_block2)_addr $(filesize); tftp $(loadaddr) part3.img; nand write $(loadaddr) f_$(data_block3)_addr $(filesize); tftp $(loadaddr) part4.img; nand write $(loadaddr) f_$(data_block4)_addr $(filesize); tftp $(loadaddr) part5.img; nand write $(loadaddr) f_$(data_block5)_addr $(filesize); tftp $(loadaddr) part6.img; nand write $(loadaddr) f_$(data_block6)_addr $(filesize)"

config BOOT_PART
    string "boot_part"
	default "1"

endif

config RESET_UBOOT_CONFIG
	string "reset_uboot_config"
	default "prot off $(f_ubootconfig_addr) $(f_ubootconfig_end); erase $(f_ubootconfig_addr) $(f_ubootconfig_end)" if ( BOOT_FROM_NOR )
	default "sf probe 3; sf write 80400000 $(f_ubootconfig_addr) $(f_ubootconfig_size)"  if ( BOOT_FROM_SPI && LANTIQ_UBOOT_ar9 ) 
	default "sf probe 0; sf write 80400000 $(f_ubootconfig_addr) $(f_ubootconfig_size)"  if ( BOOT_FROM_SPI && LANTIQ_UBOOT_amazon_se )
	default "sf probe 3; sf write 80400000 $(f_ubootconfig_addr) $(f_ubootconfig_size)"  if ( BOOT_FROM_SPI && LANTIQ_UBOOT_vr9 )
	default "sf probe 3; sf write 80400000 $(f_ubootconfig_addr) $(f_ubootconfig_size)"  if ( BOOT_FROM_SPI && LANTIQ_UBOOT_ar10 )
	default "nand write.e 80400000 $(f_ubootconfig_addr) $(f_ubootconfig_size)" if ( BOOT_FROM_NAND )

config RESET_DDR_CONFIG
    string "reset_ddr_config"
	default "prot off $(f_ddrconfig_addr) $(f_ddrconfig_end); erase $(f_ddrconfig_addr) $(f_ddrconfig_end)" if ( BOOT_FROM_NOR )
    default "sf probe 3; sf write 80400000 $(f_ddrconfig_addr) $(f_ddrconfig_size)"  if ( BOOT_FROM_SPI && LANTIQ_UBOOT_ar9 )
    default "sf probe 0; sf write 80400000 $(f_ddrconfig_addr) $(f_ddrconfig_size)"  if ( BOOT_FROM_SPI && LANTIQ_UBOOT_amazon_se	)
    default "sf probe 3; sf write 80400000 $(f_ddrconfig_addr) $(f_ddrconfig_size)"  if ( BOOT_FROM_SPI && LANTIQ_UBOOT_vr9 )
    default "sf probe 3; sf write 80400000 $(f_ddrconfig_addr) $(f_ddrconfig_size)"  if ( BOOT_FROM_SPI && LANTIQ_UBOOT_ar10 )
	default "nand write.partial 80400000 $(f_ddrconfig_addr) $(f_ddrconfig_size)" if ( BOOT_FROM_NAND )

config SW_VERSION
    string "sw_version"
	default "01-01-100"

config HW_VERSION
    string "hw_version"
	default "VR9"

config SERIAL
    string "serial"
	default "00000000"

if DUAL_IMAGE

config ROOTFSMTD2
    string "rootmtd2"
	default "/dev/mtdblock3"

config FLASHARGS2
    string "flashargs2"
    default "setenv bootargs root=$(rootfsmtd2) rw rootfstype=squashfs,jffs2 init=/etc/preinit"

config FLASH_FLASH2
	string "flash_flash2"
	default "run flashargs2 addip addmisc; bootm $(f_kernel2_addr)" if ( !BOOT_FROM_NAND )
	default "nand read.e $(loadaddr) $(f_kernel2_addr) $(f_kernel2_size); run flashargs2 addip addmisc; bootm $(loadaddr)" if ( BOOT_FROM_NAND )

endif

endmenu


source lib/Kconfig
source common/Kconfig
```
