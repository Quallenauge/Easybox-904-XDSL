## linux/linux-2.6.32.32/drivers/mtd/nand/Kconfig.ifx
```kconfig
config MTD_IFX_NAND
    tristate "IFX MTD NAND Flash Driver"
	depends on MTD_NAND && (AMAZON_SE || DANUBE || AR9 || VR9)
	default y
		
config MTD_IFX_NAND_FLASH_SIZE
    int "Maximum size for IFX flash area (MB)"
	depends on MTD_IFX_NAND && !(MTD_CMDLINE_PARTS) 
	default "4"

#config MTD_NAND_ECC_SMC
#    bool
    
config MTD_IFX_HSNAND
    tristate "IFX MTD HSNAND Flash Driver"
	depends on MTD_NAND &&  VR9
#    select MTD_NAND_ECC_SMC 
	default n

config MTD_IFX_HSNAND_FLASH_SIZE
    int "Maximum size for IFX flash area (MB)"
	depends on MTD_IFX_HSNAND && !(MTD_CMDLINE_PARTS) && VR9
	default "4"
```

## linux/linux-2.6.32.32/drivers/net/Kconfig.ifx
```kconfig
config IFX_PTM
	tristate "IFX PTM driver"
	depends on (DANUBE || AMAZON_SE || AR9 || VR9) && IFX_PPA_DATAPATH != y
	default n
	---help---
	Use this exclusively with ATM mode or Acceleration Package

choice
	prompt "RX Packet Handling Mechanism"
	depends on IFX_PTM
	default IFX_PTM_RX_NAPI

config IFX_PTM_RX_NAPI
	bool "NAPI"

config IFX_PTM_RX_TASKLET
	bool "Tasklet"
	depends on DANUBE || AMAZON_SE || AR9

config IFX_PTM_RX_INTERRUPT
	bool "Interrupt"
	depends on DANUBE || AMAZON_SE || AR9

endchoice

config IFX_PTM_TEST_PROC
	bool "IFX PTM Driver Test Proc"
	depends on IFX_PTM
	default n

config IFX_ADTRAN_PTM
	tristate "IFX PTM driver for Adtran project"
	depends on VR9 && IFX_PPA_DATAPATH != y
	default n
	---help---
	Use this exclusively with ATM mode or Acceleration Package

source "drivers/net/ifxmips_switch_api/Kconfig"

source "drivers/net/ifxmips_ppa/Kconfig"

config ASE_SWITCH_GPIO_ACCESS
    bool "Switch Access per GPIO"
    depends on AMAZON_SE
    default y
    help
	Supported only ASE, Use GPIO to access swicth instead of MDC/MDIO

config IFX_ETOP_ETHERNET
    tristate "IFX Ethernet support"
    depends on NET_ETHERNET && (AMAZON_SE || DANUBE) && IFX_PPA_DATAPATH != y
    default y
    select IFX_ETH_FRAMEWORK
    help
    Supported only Danube/ASE

choice
    prompt "Interface mode "
    depends on (IFX_ETOP_ETHERNET || IFX_PPA_DATAPATH) && AMAZON_SE
    default EPHY_MODE

config EPHY_MODE
    bool "EPHY"

config RED_MII_MAC_MODE
    bool "RedMII"
endchoice

choice
    prompt "Interface mode "
    depends on (IFX_ETOP_ETHERNET && DANUBE) 
    default REV_MII_MAC_MODE 

config REV_MII_MAC_MODE
    bool "RevMII"
endchoice

config IFX_3PORT_SWITCH
    tristate "AR9 Ethernet"
    depends on AR9 && NET_ETHERNET && IFX_PPA_DATAPATH != y
    default y
    select IFX_ETH_FRAMEWORK
    help
    Supported AR9 only

config SW_ROUTING_MODE
    bool "enable routing mode (2 interfaces)"
    depends on IFX_3PORT_SWITCH
    default y
    help
    Create two ethernet interfaces(eth0&eth1), disable internal switch bridging, otherwise, create one ethernet interface, enable internal switch bridging.

choice
    prompt "MII0 Link Setting"
    depends on IFX_3PORT_SWITCH
    default MII0_RGMII_MODE
    help
    RGMII interface is connected to externl Switch, which supported RGMII mode

config MII0_RGMII_MODE
    bool "1000MB"
endchoice

choice
    prompt "MII1 Link Setting"
    depends on IFX_3PORT_SWITCH || (AR9 && IFX_PPA_DATAPATH)
    default MII1_AUTONEG

config MII1_AUTONEG
    bool "Auto-negotiate"

config MII1_RGMII_MODE_100MB
    bool "100MB"

config MII1_RGMII_MODE
    bool "1000MB"
endchoice

#VR9 setup
config IFX_7PORT_SWITCH
    tristate "VR9 Ethernet"
    depends on VR9 && NET_ETHERNET && IFX_PPA_DATAPATH != y
    default y
    select IFX_ETH_FRAMEWORK
    help
    Supported VR9 only

config SW_ROUTING_MODE
    bool "Enable LAN and WAN interfaces (eth0-->LAN, eth1-->WAN)"
    depends on IFX_7PORT_SWITCH
    default y
    help
    Create eth0 and eth1 interfaces for routing mode (eth0-->LAN traffic, eth1-->WAN traffic). LAN and WAN group selected by Switch API.

choice
    prompt "MII0 Port enabled/disabled"
    depends on IFX_7PORT_SWITCH
    default MII0_PORT_DISABLED
    help
    Port 0 is enabled/Disabled

config MII0_PORT_ENABLED
    bool "Port 0 enabled"

config MII0_PORT_DISABLED
    bool "Port 0 Disabled"
endchoice

choice
    prompt "MII0 Interface Mode"
    depends on (IFX_7PORT_SWITCH && MII0_PORT_ENABLED)
    default MII0_RGMII_MAC_MODE
    help
     Select the interface type based on the HW board

config MII0_RGMII_MAC_MODE
    bool "RGMII MAC"
config MII0_RMII_MAC_MODE
    bool "RMII MAC "
config MII0_RMII_PHY_MODE
    bool "RMII PHY "
config MII0_MII_MAC_MODE
    bool "MII MAC  "
config MII0_MII_PHY_MODE
    bool "MII PHY  "
endchoice

choice
    prompt "MII1 Port enabled/disabled"
    depends on IFX_7PORT_SWITCH
    default MII1_PORT_DISABLED
    help
    Port 1 is enabled/Disabled

config MII1_PORT_ENABLED
    bool "Port 1 enabled"
config MII1_PORT_DISABLED
    bool "Port 1 Disabled"
endchoice

choice
    prompt "MII1 Interface Mode"
    depends on (IFX_7PORT_SWITCH && MII1_PORT_ENABLED)
    default MII1_RGMII_MAC_MODE
    help
     Select the interface type based on the HW board

config MII1_RGMII_MAC_MODE
    bool "RGMII MAC"
config MII1_RMII_MAC_MODE
    bool "RMII MAC "
config MII1_RMII_PHY_MODE
    bool "RMII PHY "
config MII1_MII_MAC_MODE
    bool "MII MAC  "
config MII1_MII_PHY_MODE
    bool "MII PHY  "
endchoice
#port2
choice
    prompt "MII2 Port enabled/disabled"
    depends on IFX_7PORT_SWITCH
    default MII2_PORT_DISABLED
    help
    Port 2 is enabled/Disabled

config MII2_PORT_ENABLED
    bool "Port 2 enabled"
config MII2_PORT_DISABLED
    bool "Port 2 Disabled"
endchoice

choice
    prompt "MII2 Interface Mode"
    depends on (IFX_7PORT_SWITCH && MII2_PORT_ENABLED)
    default MII2_GMII_MODE
    help
    GMII interface is connected 

config MII2_GMII_MODE
    bool "GMII MAC "
config MII2_MII_MAC_MODE
    bool "MII MAC  "
endchoice

#port3
choice
    prompt "MII3 Port enabled/disabled"
    depends on IFX_7PORT_SWITCH
    default MII3_PORT_DISABLED
    help
    Port 3 is enabled/Disabled

config MII3_PORT_ENABLED
    bool "Port 3 enabled"
config MII3_PORT_DISABLED
    bool "Port 3 Disabled"
endchoice
choice
    prompt "MII3 Interface Mode"
    depends on (IFX_7PORT_SWITCH && MII3_PORT_ENABLED)
    default MII3_MII_MODE
    help
    MII interface is connected 

config MII3_MII_MAC_MODE
    bool "MII MAC  "
endchoice
#port4
choice
    prompt "MII4 Port enabled/disabled"
    depends on IFX_7PORT_SWITCH
    default MII4_PORT_DISABLED
    help
    Port 4 is enabled/Disabled

config MII4_PORT_ENABLED
    bool "Port 4 enabled"
config MII4_PORT_DISABLED
    bool "Port 4 Disabled"
endchoice
choice
    prompt "MII4 Interface Mode"
    depends on (IFX_7PORT_SWITCH && MII4_PORT_ENABLED)
    default MII4_GMII_MODE
    help
    GMII interface is connected 

config MII4_GMII_MODE
    bool "GMII MAC "
config MII4_MII_MAC_MODE
    bool "MII MAC  "
endchoice
#port5
choice
    prompt "MII5 Port enabled/disabled"
    depends on IFX_7PORT_SWITCH
    default MII5_PORT_DISABLED
    help
    Port 5 is enabled/Disabled

config MII5_PORT_ENABLED
    bool "Port 5 enabled"
config MII5_PORT_DISABLED
    bool "Port 5 Disabled"
endchoice
choice
    prompt "MII5 Interface Mode"
    depends on (IFX_7PORT_SWITCH && MII5_PORT_ENABLED)
    default MII5_MII_MODE
    help
    GMII/MII interface is connected 

config MII5_RGMII_MODE
    bool "RGMII MAC"
config MII5_MII_MAC_MODE
    bool "MII MAC  "
endchoice

source "drivers/net/ifxmips_a2_se/Kconfig"

config IFX_ETH_FRAMEWORK
    bool
    default n
```

## linux/linux-2.6.32.32/drivers/net/ifxmips_a2_se/Kconfig
```kconfig
config IFX_A2_SE
	tristate "Amazon-SE ATM + ETH with EMA"
	depends on AMAZON_SE && !IFX_ATM && !IFX_PTM && !IFX_ETOP_ETHERNET && !IFX_PPA
	default n
	select IFX_ETH_FRAMEWORK

choice
    prompt "Interface mode "
    depends on IFX_A2_SE
    default EPHY_MODE

config IFX_EPHY_MODE
    bool "EPHY"

config IFX_RED_MII_MAC_MODE
    bool "RedMII"
endchoice

config IFX_ATM_TASKLET
	bool "Support Tasklet"
	depends on IFX_A2_SE
	default y
	---help---
	Use tasklet handle incoming packet. Impact on ATM RX traffic performance.

config IFX_ETH_NAPI
	bool "Support NAPI on ETH interface"
	depends on IFX_A2_SE
	default y
	---help---
	Use tasklet handle incoming ETH packet. Impact on ETH RX traffic performance.

config IFX_A2_DESC_NUM
	bool "Change Descriptor Numbers"
	depends on IFX_A2_SE
	default n
	---help---
	Change descriptor number to balance memory consumption and performance.

if IFX_A2_DESC_NUM
menu "Descriptor Numbers"

config IFX_A2_ETH_RX
	int "ETH RX Descriptor Number"
	default "32"
	---help---
	Assign descriptor number for ETH RX. Totally 4 ETH RX queues.

config IFX_A2_ETH_TX
	int "ETH TX Descriptor Number"
	default "32"
	---help---
	Assign descriptor number for ETH TX. Totally 4 ETH TX queues.

config IFX_A2_ATM_RX
	int "ATM RX Descriptor Number"
	default "32"
	---help---
	Assign descriptor number for ATM RX. Totally 2 ATM RX queues.

config IFX_A2_ATM_TX
	int "ATM TX Descriptor Number"
	default "64"
	---help---
	Assign descriptor number for ATM TX. Totally 15 ATM TX queues.

endmenu
endif
```

## linux/linux-2.6.32.32/drivers/net/ifxmips_ppa/Kconfig
```kconfig
config IFX_PPA
	bool "PPA Acceleration Package"
	depends on NET_ETHERNET
	default n
	help
	  Acceleration Package Support

config IFX_PPA_API
	tristate "PPA Acceleration Package - Kernel APIs"
	depends on IFX_PPA && IFX_PPA_DATAPATH
	default y
	help
	  PPA APIs and Kernel Hookup

config IFX_PPA_API_DIRECTPATH
	bool "Direct Path Support for PPA API"
	depends on IFX_PPA_API
	default y
	help
	  Direct Path Support (e.g. WLAN) for PPA API

config IFX_PPA_API_DIRECTPATH_BRIDGING
	bool "Bridging Support in Direct Path"
	depends on IFX_PPA_API && IFX_PPA_API_DIRECTPATH
	default y
	help
	  Let PPA accelerate bridging traffic. (Not good performance in D4/A4)

config IFX_PPA_API_PROC
	tristate "Proc Filesystem Support for PPA API"
	depends on IFX_PPA_API
	default y
	help
	  Proc Filesystem Support for PPA API

config IFX_PPA_MFE
        bool "Multiple Filed Classification and Vlan Editing"
        depends on IFX_PPA_API 
        default n
        help
          Multiple Field Classification and Vlan Editing feature PPA API

config IFX_PPA_QOS
        bool "QOS"
        depends on IFX_PPA_API
        default n
        help
          QOS support

config IFX_PPA_QOS_WFQ
        bool "QOS WFQ"
        depends on IFX_PPA_QOS
        default n
        help
          QOS WFQ support

config IFX_PPA_QOS_RATE_SHAPING
        bool "QOS Rate Shaping"
        depends on IFX_PPA_QOS
        default n
        help
          QOS Rate Shaping support

config IFX_PPA_DATAPATH
	tristate "PPA Acceleration Package - Data Path Driver"
	depends on IFX_PPA
	default y
	select IFX_ETH_FRAMEWORK
	help
	  PPA Low Level Driver (Data Path)

choice
	prompt "Package Code"
	depends on IFX_PPA_DATAPATH && (DANUBE || AMAZON_SE)
	default IFX_PPA_A4

config IFX_PPA_A4
	bool "PPA A4 Package <MII0 + ATM>"

config IFX_PPA_D4
	bool "PPA D4 Package <MII0/1>"
	depends on DANUBE

config IFX_PPA_E4
	bool "PPA E4 Package <MII0 + PTM>"
	depends on AMAZON_SE

endchoice

choice
	prompt "Package Code"
	depends on IFX_PPA_DATAPATH && (AR9 || VR9 || AR10)
	default IFX_PPA_A5

config IFX_PPA_A5
	bool "PPA A5 Package <MII0/1 + ATM>"

config IFX_PPA_D5
	bool "PPA D5 Package <MII0/1>"

config IFX_PPA_E5
	bool "PPA E5 Package <MII0/1 + PTM>"
	depends on AR9 || VR9 || AR10

endchoice

config IFX_PPE_E5_OFFCHIP_BONDING
	bool "PPA E5 Off-chip Bonding Support"
	depends on VR9 && IFX_PPA_E5
	default n

config IFX_PPA_IPv6_ENABLE
	bool "PPA IPv6 support"
	depends on IFX_PPA_DATAPATH
	default n


#ctc
config ARC_PPA_PKT_CAPTURE
	bool "Arcadyan packet capturing for Lantiq VR9 PPA"
	depends on IFX_PPA
	default y
	help
	  Arcadyan packet capturing for Lantiq VR9 PPA

config ARC_PPA_FILTER
	bool "Arcadyan PPA filter for Lantiq VR9"
	depends on IFX_PPA
	default y
	help
	  Arcadyan PPA filter for Lantiq VR9
```

## linux/linux-2.6.32.32/drivers/net/ifxmips_switch_api/Kconfig
```kconfig
#
# switch api configuration
#
config IFX_ETHSW_API
    tristate "Ethernet SWITCH API"
    default y
    help
    Support for Ethernet SWITCH API.

choice
    prompt "Support API Setting"
    depends on (IFX_ETHSW_API && AR9)
    default EXTERNAL_T3G

config BOTH_INTERFACE
    bool "Both Internal and External"

config INTERNAL_AR9
    bool "Internal TANTOS"

config EXTERNAL_T3G
    bool "External TANTOSxG"
endchoice

config IFX_ETHSW_API_COC 
    bool "Switch API CoC support"
    depends on (IFX_ETHSW_API && (AR9 || DANUBE || AMAZON_SE))
    default y
    help
    Supported AR9/DANUBE/AMAZON_SE platform

config IFX_ETHSW_API_COC_PMCU
    bool "Switch API CoC PMCU module support"
    depends on (IFX_ETHSW_API && IFX_PMCU && (AR9 || DANUBE || AMAZON_SE ))
    default y
    help
    Supported AR9/DANUBE/AMAZON_SE platform

config AMAZON_SE_TANTOS0G_GPIO
    bool "Amazon_SE Tantos0G GPIO access "
    depends on (AMAZON_SE && IFX_ETHSW_API && ASE_SWITCH_GPIO_ACCESS)
    default y
    help
    Supported AMAZON_SE only

config GPHY_DRIVER 
#    depends on (IFX_ETHSW_API && VR9)
    depends on VR9
    default y
    tristate "VR9 Internal GPHY support"
    help
    Supported Internal GPHY driver for VR9 platform

choice
    prompt "GE/SE MODE Select"
    depends on (VR9 && GPHY_DRIVER)
    default GE_MODE

config GE_MODE
    bool "Giga Ethernet Mode"

config FE_MODE
    bool "Fast Ethernet Mode"
endchoice
```

## linux/linux-2.6.32.32/drivers/pci/Kconfig.ifx
```kconfig
config IFX_PCI_BOOT
	bool "IFX PCI Bonding Boot Support"
	depends on PCI && VR9 && !IFX_PCI
	default n
	---help---
	PCI bonding boot used for DSL off-chip bonding. Only VR9 platform is supported
	To use this option, VR9 family board and bonding daughter board must connect
	each other.

config IFX_PCI
	bool "IFX PCI Support"
	depends on PCI && (DANUBE || AR9 || VR9)

config IFX_PCI_HW_SWAP
	bool "IFX PCI HW Swap"
	depends on IFX_PCI
	default y

choice
	prompt "PCI Clock Source"
	depends on IFX_PCI
	default IFX_PCI_INTERNAL_CLK_SRC_33

config IFX_PCI_INTERNAL_CLK_SRC_33
	bool "Internal Clock (33.3MHz)"

config IFX_PCI_INTERNAL_CLK_SRC_60
	bool "Internal Clock (60MHz)"

config IFX_PCI_EXTERNAL_CLK_SRC
	bool "External Clock"

endchoice

config IFX_PCI_CLOCK_DELAY_NANO_SECONDS
	int "PCI Clock Delay Value (0~7) nano seconds"
	depends on IFX_PCI
	default "1"
	range 0 7
	---help---
	  Select the clock delays in unit of 1ns. Range is 0ns - 7ns.
	  1ns works for most cases. If there is mini-pci adapter mounted,
	  2ns should be applied. If dual miniPCI mounted, 3ns should be applied.
	  However, the value depends on external PCI device.
	 
config IFX_PCI_CLOCK_DELAY_TENTH_NANO_SECOND
	int "PCI Clock Delay value (0 ~ 5) -> (0.0ns ~ 0.7ns)"
	depends on IFX_PCI
	default "0"
	range 0 5
	---help--- 
	  Select the  pci clock delay in unit of 0.1ns. Range is 0.0ns ~ 0.7ns.
	  0.0ns works for most cases. This is for fine-tuned only.
	  
config IFX_PCI_DANUBE_EBU_LED_RST
    bool "Danube V3 EBU LED Reset"
    depends on IFX_PCI && DANUBE
    default n
    ---help---
      Danube V3 uses EBU LED for external PCI device reset. Other versions and platforms still use
      GPIO 21 as reset pin
            
config IFX_DUAL_MINI_PCI
	bool "IFX Dual Mini-PCI Support"
	depends on IFX_PCI
	default n
```
