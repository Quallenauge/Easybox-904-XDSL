## linux/linux-2.6.32.32/drivers/pci/pcie/Kconfig.ifx
```kconfig
config IFX_PCIE
	bool "IFX PCIE Support"
	depends on PCIEPORTBUS && (VR9 || AR10)

choice
	prompt "IFX PCIE: Default PCIe PHY Clock Mode"
	### ctc ###
#	depends on IFX_PCIE
	###########
	default IFX_PCIE_PHY_36MHZ_MODE
	---help---
	  Select ifx pci express phy clock mode by default.
	config IFX_PCIE_PHY_36MHZ_MODE
	    bool "36MHz"
	
	config IFX_PCIE_PHY_25MHZ_MODE
	    bool "25MHz"

	config IFX_PCIE_PHY_100MHZ_MODE
	    bool "100MHz"
endchoice

config IFX_PCIE_1ST_CORE
	bool "IFX PCIE CORE 0 Support"
	depends on IFX_PCIE
	default y

config IFX_PCIE_HW_SWAP
	bool "IFX PCIE Core 0 CFG/IO/MEM Hardware Swap Support"
	depends on IFX_PCIE_1ST_CORE
	default y
	---help---
	  This will enable PCIe Core 0 configuration, io/memory space swap. EP register read/write must swap

config IFX_PCIE_VR9_A11_HRST
	bool "IFX PCIE Core 0 VR9 A11 chip POR Hardware Reset Support"
	depends on IFX_PCIE_1ST_CORE && VR9
	default n
	---help---
	  This will enable PCIe Core 0 RC to use RCU_REQ_RST Hardware to reset EP. By default, 
	  GPIO 38 will be used for external PCIe EP reset

config IFX_PCIE_2ND_CORE
	bool "IFX PCIE Core 1 Support"
	depends on IFX_PCIE && AR10
	default n
	---help---
	  This will enable 2nd PCIe RC support

config IFX_PCIE1_HW_SWAP
	bool "IFX PCIE Core 1 CFG/IO/MEM Hardware Swap Support"
	depends on IFX_PCIE_2ND_CORE
	default n
	---help---
	  This will enable PCIe Core 1 configuration, io/memory space swap. EP register read/write must swap
```

## linux/linux-2.6.32.32/drivers/serial/Kconfig.ifx
```kconfig
config SERIAL_IFX_ASC
	bool "IFX UART"
	depends on DANUBE || AMAZON_SE || AR9 || VR9 || AR10
	select SERIAL_CORE

config IFX_ASC_DEFAULT_BAUDRATE
	int "Serial Default Baudrate"
	depends on SERIAL_IFX_ASC
	default "115200"
	help
	  Use default baudrate to setup UART port, so that message can be
	  printed (with function prom_printf) before Linux console is ready.

config IFX_DISABLE_ASC0
	bool "Disable ASC0"
	depends on SERIAL_IFX_ASC && (DANUBE || AR9)
	default n
	help
	  Danube and AR9 has two ASC (UART) port - ASC0 and ASC1. Since ASC0
	  occupy a set of GPIO pins, this option is available to disable ASC0
          and release this set of GPIO pins.

config SERIAL_IFX_ASC_CONSOLE
	bool "Serial Console Support"
	depends on SERIAL_IFX_ASC
	default y
	select SERIAL_CORE_CONSOLE

choice
	prompt "Serial Console on ..."
	depends on SERIAL_IFX_ASC_CONSOLE
	default IFX_ASC_CONSOLE_ASC1

config IFX_ASC_CONSOLE_ASC0
	bool "ASC0"
	depends on (DANUBE || AR9) && !IFX_DISABLE_ASC0
	help
	  Use UART port 0 to print message (with function prom_printf) before
	  Linux console is ready.

config IFX_ASC_CONSOLE_ASC1
	bool "ASC1"
	help
	  Use UART port 1 to print message (with function prom_printf) before
	  Linux console is ready.

endchoice

config SERIAL_IFX_USIF_UART
	bool "IFX USIF UART"
	depends on VR9 && !IFX_USIF_SPI
	select SERIAL_CORE
	default n
	help
	  IFX USIF UART mode driver

config IFX_USIF_UART_CONSOLE
	bool "IFX USIF UART Cosnole"
	depends on SERIAL_IFX_USIF_UART
	select SERIAL_CORE_CONSOLE
	default n

config IFX_USIF_UART_DEFAULT_BAUDRATE
	depends on SERIAL_IFX_USIF_UART
	int "IFX_USIF UART Default Baudrate"
	default "115200"
```

## linux/linux-2.6.32.32/drivers/spi/Kconfig.ifx
```kconfig
config IFX_SPI
	tristate "IFX SPI/SSC driver"
	depends on SPI_MASTER && (AMAZON_SE || DANUBE || AR9 || VR9 || AR10)
	default n

config IFX_SPI_DEBUG
    bool "IFX SPI/SSC runtime debug support"
    depends on IFX_SPI
    default n
    ----help---
    Choose this option to enable IFX SPI/SSC runtime debug options. This can be enabled by writing debug options into /proc/sys/dev/ifx_ssc/debug.

config IFX_SPI_ASYNCHRONOUS
	bool "IFX SPI/SSC tasklet support" 
	depends on IFX_SPI && (DANUBE || AR9 || VR9)
	default y
	---help---
	Choose this option to support synchronous and asynchronous APIs at the same time. SPI itself will run    in tasklet. If not, only synchronous API is supported. SPI context will in kernel thread mode and bel    -ong to caller's context. 

config IFX_SPI_EEPROM
	tristate "IFX SPI/SSC EPROM driver"
	depends on IFX_SPI && !IFX_SPI_FLASH
	default n

config IFX_SPI_FLASH
	tristate "IFX SPI/SSC 25 types of serial flash driver"
	depends on IFX_SPI
	default n

config IFX_SPI_AT45_FLASH
	tristate "IFX SPI/SSC atmel45xxx flash driver"
	depends on IFX_SPI
	default n

config IFX_USIF_SPI
	tristate "IFX USIF SPI driver"
	depends on SPI_MASTER && (VR9 || AR10)
	default n

config IFX_USIF_SPI_DEBUG
    bool "IFX USIF SPI runtime debug support"
    depends on IFX_USIF_SPI
    default n
    ----help---
    Choose this option to enable USIF SPI runtime debug options. This can be enabled by writing debug options into /proc/sys/dev/ifx_usif_spi/debug.

config IFX_USIF_SPI_ASYNCHRONOUS
    bool "IFX USIF SPI tasklet support"
    depends on IFX_USIF_SPI
    default y
    ---help---
    Choose this option to support synchronous and asynchronous APIs at the same time. USIF SPI itself will run in tasklet. If not, only synchronous API is supported. SPI context will in kernel thread mode and belong to caller's context.

config IFX_USIF_SPI_FLASH
	tristate "IFX USIF SPI 25 types of serial flash driver"
	depends on IFX_USIF_SPI
	default n
	
config IFX_USIF_AT45_FLASH
    tristate "IFX atmel45xxx flash driver"
    depends on IFX_USIF_SPI
    default n
```

## linux/linux-2.6.32.32/drivers/usb/gadget/Kconfig.ifx
```kconfig
config USB_GADGET_IFX_0
	boolean "Infineon USB Gadget Controller Driver" if ( !AMAZON_S && !AR9 && !VR9 && !VR10 && !MIPS_AMAZON_S && !MIPS_AR9 && !MIPS_VR9 && !MIPS_AR10 )
	depends on ( !AMAZON_S && !AR9 && !VR9 && !AR10 && !MIPS_AMAZON_S && !MIPS_AR9 && !MIPS_VR9 && !MIPS_AR10 )
	select USB_GADGET_SELECTED
	help
	    Infineon USB Gadget Controller

config USB_GADGET_IFX
	tristate
	depends on  USB_GADGET_IFX_0
	default USB_GADGET
	select USB_GADGET_SELECTED
	select USB_GADGET_DUALSPEED


config USB_GADGET_IFX_1
	boolean "Amazon-S USB Gadget Controller Driver No 1"  if ( AMAZON_S || AR9 || VR9 || AR10 || MIPS_AMAZON_S || MIPS_AR9 || MIPS_VR9 || MIPS_AR10 )
	depends on ( AMAZON_S || AR9 || VR9 || AR10 || MIPS_AMAZON_S || MIPS_AR9 || MIPS_VR9 || MIPS_AR10 )
	select USB_GADGET_SELECTED
	help
	    Infineon USB Gadget Controller

config USB_GADGET_IFX
	tristate
	depends on  USB_GADGET_IFX_1
	default USB_GADGET
	select USB_GADGET_SELECTED
	select USB_GADGET_DUALSPEED

config USB_GADGET_IFX_2
	boolean "Amazon-S USB Gadget Controller Driver No 2" if ( AMAZON_S || AR9 || VR9 || AR10 || MIPS_AMAZON_S || MIPS_AR9 || MIPS_VR9 || MIPS_AR10 )
	depends on ( AMAZON_S || AR9 || VR9 || AR10 || MIPS_AMAZON_S || MIPS_AR9 || MIPS_VR9 || MIPS_AR10 )
	select USB_GADGET_SELECTED
	help
	    Infineon USB Gadget Controller

config USB_GADGET_IFX
	tristate
	depends on  USB_GADGET_IFX_2
	default USB_GADGET
	select USB_GADGET_SELECTED
	select USB_GADGET_DUALSPEED
```

## linux/linux-2.6.32.32/drivers/usb/gadget/Kconfig.ifx.opt
```kconfig
config USB_GADGET_IFX_FORCE_USB11
	boolean "Forced USB1.1"
	depends on USB_GADGET_IFX
	default n
	help
	force to be USB 1.1

config USB_GADGET_IFX_LED
	boolean "Infineon USB Gadget LED Support"
	depends on USB_GADGET_IFX
	default n
	help
	Infineon USB Gadget LED Support

config USB_GADGET_IFX_COC
	boolean "Infineon USB Gadget CoC Support"
	depends on USB_GADGET_IFX
	default n
	help
	Infineon USB Gadget CoC Support

choice
	prompt "IFX unaligned buffer policy"
	depends on USB_GADGET_IFX
	help
	   IFX unaligned buffer policy

config USB_GADGET_IFX_UNALIGNED_ADJ
	boolean "Adjust"
	help
	USB_GADGET_IFX_UNALIGNED_ADJ

config USB_GADGET_IFX_UNALIGNED_CHK
	boolean "Check-only"
	help
	USB_GADGET_IFX_UNALIGNED_CHK

config USB_GADGET_IFX_UNALIGNED_NONE
	boolean "No process"
	help
	USB_GADGET_IFX_UNALIGNED_NONE

endchoice
```

## linux/linux-2.6.32.32/net/Kconfig.ifx
```kconfig
config IFX_IGMP_PROXY
        tristate "IGMP Proxy & Snooping support"
	depends on m
	default n
        help
          Infineon IGMP Proxy & Snooping support

config IFX_IGMP_SNOOPING
        tristate "IGMP Proxy & Snooping support"
	default n
        help
          Lantiq IGMPv3 Proxy & Snooping support

config IFX_MCAST_FASTPATH
		tristate "IPv4 Multicast Acceleration"
		default y
		help
			IPv4 Multicast Acceleration.
```

## linux/linux-2.6.32.32/net/atm/Kconfig.ifx
```kconfig
config IFX_OAM
	tristate "IFX OAM support"
	depends on ATM && NET
	default n
	---help---
	IFX OAM support
```
